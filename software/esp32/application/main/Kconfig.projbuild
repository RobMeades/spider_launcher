## software/esp32/application/main/Kconfig.projbuild
```kconfig
menu "Application Configuration"

    config SPIDER_LAUNCHER_AUDIO_USE_GPIO
        bool
        default y if SPIDER_LAUNCHER_AUDIO_UART_NUM < 0
        default n

    config SPIDER_LAUNCHER_AUDIO_PIN_0
        int "Audio pin 0"
        default 44
        depends on SPIDER_LAUNCHER_AUDIO_USE_GPIO
        help
            GPIO pin wired to pin IO0 of the DY-HV8F audio board,
            used if SPIDER_LAUNCHER_UART_NUM is -1.

    config SPIDER_LAUNCHER_AUDIO_PIN_1
        int "Audio pin 1"
        default 43
        depends on SPIDER_LAUNCHER_AUDIO_USE_GPIO
        help
            GPIO pin wired to pin IO1 of the DY-HV8F audio board,
            used if SPIDER_LAUNCHER_UART_NUM is -1.

    config SPIDER_LAUNCHER_AUDIO_PIN_2
        int "Audio pin 2"
        default 5
        depends on SPIDER_LAUNCHER_AUDIO_USE_GPIO
        help
            GPIO pin wired to pin IO2 of the DY-HV8F audio board,
            used if SPIDER_LAUNCHER_UART_NUM is -1.

    config SPIDER_LAUNCHER_AUDIO_PIN_3
        int "Audio pin 3"
        default 4
        depends on SPIDER_LAUNCHER_AUDIO_USE_GPIO
        help
            GPIO pin wired to pin IO3 of the DY-HV8F audio board,
            used if SPIDER_LAUNCHER_UART_NUM is -1.

    config SPIDER_LAUNCHER_AUDIO_UART_TXD_PIN
        int "Audio TXD pin"
        default 43
        depends on !SPIDER_LAUNCHER_AUDIO_USE_GPIO
        help
            UART TX pin wired to the UART Rx pin of the DY-HV8F audio board,
            ignored if SPIDER_LAUNCHER_UART_NUM is -1.

    config SPIDER_LAUNCHER_AUDIO_UART_RXD_PIN
        int "Audio RXD pin"
        default 44
        depends on !SPIDER_LAUNCHER_AUDIO_USE_GPIO
        help
            UART RX pin wired to the UART Tx pin of the DY-HV8F audio board,
            ignored if SPIDER_LAUNCHER_UART_NUM is -1.

    config SPIDER_LAUNCHER_AUDIO_UART_NUM
        int "Audio UART number"
        default -1
        help
            UART number to use for communications with the DY-HV8F audio board,
            if -1 then the SPIDER_LAUNCHER_AUDIO_PIN_x will be used to
            address the audio board with individual IOs instead.

    config SPIDER_LAUNCHER_AUDIO_UART_BAUD_RATE
        int "UART baud rate for audio"
        default 9600
        depends on !SPIDER_LAUNCHER_AUDIO_USE_GPIO
        help
            Baud rate on the UART talking to the DY-HV8F audio board

endmenu
```

## software/esp32/components/fgr_debug/Kconfig.projbuild
```kconfig
menu "FGR Debug Configuration"

    config FGR_DEBUG_LED_PIN
        int "Debug LED pin"
        default 21
        help
            The pin where a debug LED is connected: on an ESP32 C3 super mini board
            a single colour debug LED is usually on pin 8 whereas on an ESP32 S3
            super mini board the WS2812 RGB LED is usually on pin 21 (and
            you will need to set CONFIG_FGR_DEBUG_LED_SPI_NUM also).

    config FGR_DEBUG_LED_SPI_NUM
        int "The SPI port to use for a WS2812 RGB LED"
        default 2
        range -1 2
        help
            Set this to -1 for a single colour LED (e.g. as usually found on an
            ESP32 C3 super mini board), set it to a valid SPI HW block number
            for the WS2812 RGB LED usually found on the ESP32 S3 super mini board
            DO NOT USE SPI 0 (which maps to SPI1): as it is hard-wired internally
            to flash memory.  The default here of 2 maps to SPI3, leaving 1
            (which maps to SPI2) for other uses.

    config FGR_DEBUG_LED_WS2812_GRB
        bool "Set this if your WS2812 LED uses order GRB instead of RGB"
        depends on FGR_DEBUG_LED_SPI_NUM > 0
        default n
        help
            Some WS2812 tri-colour LEDs expect to be told GRB instead of RGB.

endmenu
```

## software/esp32/components/tmc5160/Kconfig.projbuild
```kconfig
menu "TMC5160 Configuration"

    config TMC5160_SPI_NUM
        int "The SPI port to use to talk to a TMC5160 stepper motor controller"
        default 1
        range -1 2
        help
            DO NOT USE SPI 0 (which maps to SPI1) as it is hard-wired internally
            to flash memory.  The default here of 1 maps to SPI2, leaving 2
            (which maps to SPI3) for other uses.

    config TMC5160_SPI_SCK_PIN
        int "TMC5160 SPI clock GPIO"
        default 7

    config TMC5160_SPI_MOSI_PIN
        int "TMC5160 SPI MOSI GPIO (SDI)"
        default 6

    config TMC5160_SPI_MISO_PIN
        int "TMC5160 SPI MISO GPIO (SDO)"
        default 8

    config TMC5160_SPI_CS_PIN
        int "TMC5160 SPI chip select GPIO (CSN)"
        default 1

    config TMC5160_SPI_CLOCK_HZ
        int "TMC5160 SPI clock frequency (Hz)"
        default 1000000
        range 100000 4000000

    config TMC5160_ENABLE_PIN
        int "stepper enable pin"
        default 9
        help
            Pin connected to the TMC5160 EN pin

endmenu
```
